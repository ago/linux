## drivers/pps/clients/Kconfig
```kconfig
#
# PPS clients configuration
#

if PPS

comment "PPS clients support"

config PPS_CLIENT_PARPORT
	tristate "Parallel port PPS client"
	depends on PPS && PARPORT
	help
	  If you say yes here you get support for a PPS source connected
	  with the interrupt pin of your parallel port.

endif
```
